//*****************************************************************
//  Command file for IAR Linker
//
//  Generates appropriate mappings for objects in memory
//  
//
//  Copyright (c) 2007-2008, Sergey A. Borshch
//
//  $Revision$
//  $Date::  $
//
//*****************************************************************

-carm

// place code to RAM
-DROMSTART=40000040
-DROMEND=40001FFF   // any LPC (except 2101, 2102) has at least 8K RAM, enought for example

-DRAMSTART=40000040
-DRAMEND=40001FFF   // any LPC (except 2101, 2102) has at least 8K RAM, enought for example

// Intvec always linked to 0x00-0x3F
-Z(CODE)INTVEC=00000000-0000003F

// place INTVEC init data to remappable area of RAM
-Z(CODE)INTVEC_ID=40000000-4000003F
-QINTVEC=INTVEC_ID

// ROM
-Z(CODE)ICODE,DIFUNCT,SWITAB,CODE=ROMSTART-ROMEND
-Z(CONST)INITTAB,DATA_ID,DATA_C=ROMSTART-ROMEND
-Z(CONST)CODE_ID=ROMSTART-ROMEND    // __ramfunc code init data

// RAM
-Z(DATA)DATA_I,DATA_Z,DATA_N=RAMSTART-RAMEND
-Z(DATA)CODE_I=RAMSTART-RAMEND      // __ramfunc code in ram

-QCODE_I=CODE_ID

-D_HEAP_SIZE=(0)                    // heap not used in samples
-Z(DATA)HEAP+_HEAP_SIZE=RAMSTART-RAMEND

// CSTACK used only before OS start, when IRQ's are disabled
// So don't allocate space for CSTACK, let it overlaps IRQ stack
-D_CSTACK_SIZE=(0x0)                // CSTACK not used

-D_IRQ_STACK_SIZE=(0x100)           // 256 bytes for IRQ's

// place CSTACK at the bottom of RAM
-Z(DATA)CSTACK+_CSTACK_SIZE#RAMSTART-RAMEND
// place IRQ stack just before CSTACK (actualy at same addresses)
-Z(DATA)IRQ_STACK+_IRQ_STACK_SIZE#RAMSTART-RAMEND
