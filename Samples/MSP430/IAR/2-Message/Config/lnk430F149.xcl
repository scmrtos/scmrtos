//*****************************************************************
//  XLINK command file for the MSP430 IAR C/EC++ Compiler
//
//  This is the XLINK command file for the MSP430F149
//  microprocessor.
//
//  Usage:  xlink  your_file(s)  -f lnkMSP430F149  cl430xxx
//
//  $Revision: 1.1.1.1 $
//
//*****************************************************************


//*****************************************************************
//  The following segments are defined in this linker command file:
//
//  Data read/write segments (RAM)
//  ==============================
//
//  segment     address range   usage
//  -------     -------------   --------------------------
//  DATA16_I    0200-0A00       Initialized variables
//  DATA16_Z    0200-0A00       Zero initialized variables
//  DATA16_N    0200-0A00       Uninitialized variables
//  CSTACK      0200-0A00       Run-time stack/auto variables
//  HEAP        0200-0A00       The heap used by malloc and free in DLIB
//
//
//  Program and non-volatile segments (FLASH)
//  =========================================
//
//  segment     address range   usage
//  -------     -------------   --------------------------
//  INFO        1000-10FF       Information memory
//  CSTART      1100-FFDF       cstartup program code
//  CODE        1100-FFDF       Program code
//  DATA16_C    1100-FFDF       Constant "const" variables AND String literals
//  DATA16_ID   1100-FFDF       Initializers for DATA16_I
//  DIFUNCT     1100-FFDF       Dynamic initialization vector used by C++
//  CHECKSUM    1100-FFDF       The linker places the checksum byte(s) in this segment,
//                              when the -J linker command line option is used.
//
//  INTVEC      FFE0-FFFF       Interrupt vectors
//
//  NOTE:
//  It is not possible to pack the CSTART segment by using the XLINK -P option
//  Special function registers and peripheral modules occupy addresses 0-01FFh
//  Be sure to use end values for the defined addresses
//*****************************************************************

// -------------------------------------------------------------------
// Stack size and, for DLIB, heap size
// -------------------------------------------------------------------

// Uncomment for command line use
-D_STACK_SIZE=50
-D_HEAP_SIZE=50

// -------------------------------------------------------------------
// Define CPU
// -------------------------------------------------------------------

-cmsp430

// -------------------------------------------------------------------
// RAM memory
// -------------------------------------------------------------------

-Z(DATA)DATA16_I,DATA16_Z,DATA16_N,HEAP+_HEAP_SIZE=0200-0A00
-Z(DATA)CSTACK+_STACK_SIZE#

// -------------------------------------------------------------------
//  Information memory (FLASH)
// -------------------------------------------------------------------

-Z(CODE)INFO=1000-10FF
-Z(CODE)INFOA=1080-10FF
-Z(CODE)INFOB=1000-107F


// -------------------------------------------------------------------
// ROM memory (FLASH)
// -------------------------------------------------------------------

//  Code 

-Z(CODE)CSTART=1100-FFDF
-Z(CODE)CODE=1100-FFDF


// Constant data

-Z(CONST)DATA16_C,DATA16_ID,DIFUNCT,CHECKSUM=1100-FFDF


// Interrupt vectors

-Z(CONST)INTVEC=FFE0-FFFF
-Z(CONST)RESET=FFFE-FFFF


// -------------------------------------------------------------------
// End of File
// -------------------------------------------------------------------
