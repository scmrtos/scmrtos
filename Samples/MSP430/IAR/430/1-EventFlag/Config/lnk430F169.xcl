//*****************************************************************
//
// XLINK command file for IAR Embedded Workbench for MSP430.
//
// This file should be used with the MSP430F169 microprocessor.
//
// Copyright 1996-2007 IAR Systems. All rights reserved.
//
// Usage:  xlink your_file(s) -f lnk430f169 library
//
// $Revision: 1.30 $
//
//*****************************************************************

//*****************************************************************
//
// The memory areas of the MSP430F169 microprocessor:
//
//   Peripheral units:                0 - 01FF
//
//   Information memory (FLASH):   1000 - 10FF
//
//   Read-write memory (RAM):      0200 - 09FF
//
//   Read-only memory (FLASH):     1100 - FFDF
//                                 
//
//*****************************************************************

//*****************************************************************
//
// The following segments are defined in this linker command file:
//
// Data read/write segments (RAM)
// ==============================
//
// segment     Restrictions    Usage
// -------     ------------    --------------------------
// DATA16_I    < 10000         Data16 initialized variables
// DATA16_Z    < 10000         Data16 zero initialized variables
// DATA16_N    < 10000         Data16 uninitialized variables
// DATA16_HEAP < 10000         Data16 heap used by malloc and free
// DATA20_I                    Data20 initialized variables
// DATA20_Z                    Data20 zero initialized variables
// DATA20_N                    Data20 uninitialized variables
// DATA20_HEAP                 Data20 heap used by malloc and free
// CSTACK      < 10000         Runtime stack
//
//
// Program and data read-only segments (FLASH)
// ===========================================
//
// segment     Restrictions    Usage
// -------     ------------    --------------------------
// INFO                        Information memory
// CSTART      < 10000         Program startup code
// CODE                        Program code
// ISR_CODE    < 10000         Program code for interrupt service routines
// DATA16_C    < 10000         Data16 constant data and string literals
// DATA16_ID   < 10000         Data16 initializers for DATA16_I
// DATA20_C                    Data20 constant data and string literals
// DATA20_ID                   Data20 initializers for DATA20_I
// DIFUNCT     < 10000         Dynamic initialization vector used by C++
// CHECKSUM                    Checksum byte(s) generated by the -J option
// INTVEC      FFE0-FFFF       Interrupt vectors
// RESET       FFFE-FFFF       The reset vector
//
//*****************************************************************


// ---------------------------------------------------------
// Stack and heap sizes.
// ---------------------------------------------------------

// Uncomment for command line use
-D_STACK_SIZE=50
-D_DATA16_HEAP_SIZE=50


// ---------------------------------------------------------
// Define cpu.
// ---------------------------------------------------------

-cmsp430


// ---------------------------------------------------------
// Read-write memory.
// ---------------------------------------------------------

-Z(DATA)DATA16_I,DATA16_Z,DATA16_N,DATA16_HEAP+_DATA16_HEAP_SIZE=0200-09FF
-Z(DATA)CSTACK+_STACK_SIZE#


// ---------------------------------------------------------
// Read only memory


// ---------------------------------------------------------
// Information memory
// ---------------------------------------------------------

-Z(CODE)INFO=1000-10FF
-Z(CODE)INFOA=1080-10FF
-Z(CODE)INFOB=1000-107F



// ---------------------------------------------------------
// Constant data
// ---------------------------------------------------------

-Z(CONST)DATA16_C,DATA16_ID,DIFUNCT=1100-FFDF


// ---------------------------------------------------------
// Code
// ---------------------------------------------------------

-Z(CODE)CSTART,ISR_CODE=1100-FFDF
-P(CODE)CODE=1100-FFDF


// ---------------------------------------------------------
// Interrupt vectors
// ---------------------------------------------------------

-Z(CODE)INTVEC=FFE0-FFFF
-Z(CODE)RESET=FFFE-FFFF


// ---------------------------------------------------------
// The end
// ---------------------------------------------------------
