//******************************************************************************
//*
//*     FULLNAME:  Single-Chip Microcontroller Real-Time Operating System
//*
//*     NICKNAME:  scmRTOS
//*
//*     PROCESSOR: ADuc70xx (Analog Devices)
//*
//*     TOOLKIT:   EWARM (IAR Systems)
//*
//*     PURPOSE:   Linker control file
//*
//*     Version:   3.00-beta
//*
//*     $Revision$
//*     $Date$
//*
//*     Copyright (c) 2003-2006, Harry E. Zhurov
//*
//*     Permission is hereby granted, free of charge, to any person 
//*     obtaining  a copy of this software and associated documentation 
//*     files (the "Software"), to deal in the Software without restriction, 
//*     including without limitation the rights to use, copy, modify, merge, 
//*     publish, distribute, sublicense, and/or sell copies of the Software, 
//*     and to permit persons to whom the Software is furnished to do so, 
//*     subject to the following conditions:
//*
//*     The above copyright notice and this permission notice shall be included 
//*     in all copies or substantial portions of the Software.
//*
//*     THE SOFTWARE IS PROVIDED "AS IS", WITHOUT WARRANTY OF ANY KIND, 
//*     EXPRESS  OR IMPLIED, INCLUDING BUT NOT LIMITED TO THE WARRANTIES OF 
//*     MERCHANTABILITY, FITNESS FOR A PARTICULAR PURPOSE AND NONINFRINGEMENT. 
//*     IN NO EVENT SHALL THE AUTHORS OR COPYRIGHT HOLDERS BE LIABLE FOR ANY 
//*     CLAIM, DAMAGES OR OTHER LIABILITY, WHETHER IN AN ACTION OF CONTRACT, 
//*     TORT OR OTHERWISE, ARISING FROM, OUT OF OR IN CONNECTION WITH 
//*     THE SOFTWARE OR THE USE OR OTHER DEALINGS IN THE SOFTWARE.
//*
//*     =================================================================
//*     See http://scmrtos.sourceforge.net for documentation, latest
//*     information, license and contact details.
//*     =================================================================
//*
//******************************************************************************
//*     ARM port by Sergey A. Borshch, Copyright (c) 2006

-cARM
// place code to flash
-DROMSTART=00000040         // reserve space for INTVEC
-DROMEND=00007FFF           // any ADuC70xx has as little as 32K flash
-DRAMSTART=00010000
-DRAMEND=00010FFF           // any ADuC70xx has as little as 8K RAM

// Intvec always linked to 0x00-0x3F
-Z(CODE)INTVEC=00-3F

// ROM
-Z(CODE)ICODE,DIFUNCT,SWITAB,CODE,INITTAB,DATA_ID,DATA_C=ROMSTART-ROMEND

// RAM
-Z(DATA)DATA_I,DATA_Z,DATA_N=RAMSTART-RAMEND

-Z(CONST)CODE_ID=ROMSTART-ROMEND    // __ramfunc code init data
-Z(DATA)CODE_I=RAMSTART-RAMEND      // __ramfunc code in ram
-QCODE_I=CODE_ID

-D_HEAP_SIZE=(0)                    // heap not used in samples
-Z(DATA)HEAP+_HEAP_SIZE=RAMSTART-RAMEND

// CSTACK used only before OS start, when IRQ's are disabled
// So don't allocate space for CSTACK, let it overlaps IRQ stack
-D_CSTACK_SIZE=(0x0)                // CSTACK not used

-D_IRQ_STACK_SIZE=(0x100)           // 256 bytes for IRQ's

// place CSTACK at the bottom of RAM
-Z(DATA)CSTACK+_CSTACK_SIZE#RAMSTART-RAMEND
// place IRQ stack just before CSTACK (actualy at same addresses)
-Z(DATA)IRQ_STACK+_IRQ_STACK_SIZE#RAMSTART-RAMEND
