//********************************************************************************
//*
//*     FULLNAME:  Single-Chip Microcontroller Real-Time Operating System
//*
//*     NICKNAME:  scmRTOS
//*
//*     PROCESSOR: LPC2xxx (NXP)
//*
//*     TOOLKIT:   EWARM (IAR Systems)
//*
//*     PURPOSE:   Linker control file
//*
//*     Version:   3.00-beta
//*
//*     $Revision: 39 $
//*     $Date: 2006-12-17 17:46:00 +0200 (Вс, 17 дек 2006) $
//*
//*     Copyright (c) 2003-2006, Harry E. Zhurov
//*
//*     =================================================================
//*     scmRTOS is free software; you can redistribute it and/or
//*     modify it under the terms of the GNU General Public License
//*     as published by the Free Software Foundation; either version 2
//*     of the License, or (at your option) any later version.
//*
//*     This program is distributed in the hope that it will be useful,
//*     but WITHOUT ANY WARRANTY; without even the implied warranty of
//*     MERCHANTABILITY or FITNESS FOR A PARTICULAR PURPOSE.  See the
//*     GNU General Public License for more details.
//*
//*     You should have received a copy of the GNU General Public License
//*     along with this program; if not, write to the Free Software
//*     Foundation, Inc., 51 Franklin Street, Fifth Floor, Boston,
//*     MA  02110-1301, USA.
//*     =================================================================
//*
//*     =================================================================
//*     See http://scmrtos.sourceforge.net for documentation, latest
//*     information, license and contact details.
//*     =================================================================
//*
//********************************************************************************
//*     ARM port by Sergey A. Borshch, Copyright (c) 2006

-carm

// place code to RAM
-DROMSTART=40000040
-DROMEND=40001FFF   // any LPC (except 2101, 2102) has at least 8K RAM, enought for example

-DRAMSTART=40000040
-DRAMEND=40001FFF   // any LPC (except 2101, 2102) has at least 8K RAM, enought for example

// Intvec always linked to 0x00-0x3F
-Z(CODE)INTVEC=00000000-0000003F

// place INTVEC init data to remappable area of RAM
-Z(CODE)INTVEC_ID=40000000-4000003F
-QINTVEC=INTVEC_ID

// ROM
-Z(CODE)ICODE,DIFUNCT,SWITAB,CODE=ROMSTART-ROMEND
-Z(CONST)INITTAB,DATA_ID,DATA_C=ROMSTART-ROMEND
-Z(CONST)CODE_ID=ROMSTART-ROMEND    // __ramfunc code init data

// RAM
-Z(DATA)DATA_I,DATA_Z,DATA_N=RAMSTART-RAMEND
-Z(DATA)CODE_I=RAMSTART-RAMEND      // __ramfunc code in ram

-QCODE_I=CODE_ID

// irq stack not used, don't reserve space
-Z(DATA)IRQ_STACK=RAMSTART-RAMEND

-DSTACK_SIZE=100
// CSTACK used instead of IRQ_STACK
// place interupt stack at the bottom of RAM
-Z(DATA)CSTACK+STACK_SIZE#RAMSTART-RAMEND
